;**************************************************************************************
;PROGRAM		:	BLDC OPEN LOOP SPEED CONTROL USING HALL SENSORS ON PICDEM MC LV BOARD
;MICROCONTROLLER	:	PIC18FXX31
;CRYSTAL FREQUENCY	:	5MHZ (X4 PLL)
;**************************************************************************************
;AUTHOR			:	PADMARAJA YEDAMALE
;			:	RAKESH PAREKH
;DATE			:	01-APR-2005
;VERSION		:	V1.0
;**************************************************************************************
;*
;* Software License Agreement
;*
;* The software supplied herewith by Microchip Technology Incorporated
;* (the “Company”) for its PICmicro® Microcontroller is intended and
;* supplied to you, the Company’s customer, for use solely and
;* exclusively on Microchip PICmicro Microcontroller products. The
;* software is owned by the Company and/or its supplier, and is
;* protected under applicable copyright laws. All rights are reserved.
;* Any use in violation of the foregoing restrictions may subject the
;* user to criminal sanctions under applicable laws, as well as to
;* civil liability for the breach of the terms and conditions of this
;* license.
;*
;* THIS SOFTWARE IS PROVIDED IN AN “AS IS” CONDITION. NO WARRANTIES,
;* WHETHER EXPRESS, IMPLIED OR STATUTORY, INCLUDING, BUT NOT LIMITED
;* TO, IMPLIED WARRANTIES OF MERCHANTABILITY AND FITNESS FOR A
;* PARTICULAR PURPOSE APPLY TO THIS SOFTWARE. THE COMPANY SHALL NOT,
;* IN ANY CIRCUMSTANCES, BE LIABLE FOR SPECIAL, INCIDENTAL OR
;* CONSEQUENTIAL DAMAGES, FOR ANY REASON WHATSOEVER.

;**************************************************************************************
;THIS FILE CONTAINS ROUTINES FOR SERIAL COMMUNICATION FROM MC_GUI TO AND FROM PICDEM BOARD USING PIC18FXX31
;ROUTINES ARE PARSING COMMAND FROM GUI, ACKNOWLEDGEMENT TO GUI AND RESPONSE TO GUI
;FOR ADDITIONAL INFORMATION ON IMPLEMENTED SERIAL COMMUNICATION PROTOCOL,
;REFER MICROCHIP APPLICATION NOTE AN819
;**************************************************************************************

	INCLUDE	<P18F2431.INC>
	INCLUDE <INTERFACEBLDCCONSTANT.INC>
	INCLUDE <INTERFACEBLDCVAR.INC>
	
#IF ((ACTIVE_MODE == 0X01) || (ACTIVE_MODE == 0X02))	
	GLOBAL	PARSE_HOSTCMD_FSM,PARSE_HOSTCMD_RESET,ACKNOWLEDGE_HOST,SEND_HOSTDATA
	EXTERN	UARTINT_GETCH,HOSTBUF_PUTCH,RESPONSEBUF_GETCH,RESPONSEBUF_PUTCH,UARTINT_PUTCH

SERIAL  CODE
;***************************************************************************
;ROUTINE TO PARSE DATA FROM HOST PC IN DEFINED SERIAL PROTOCOL FORMATE
;***************************************************************************
PARSE_HOSTCMD_ERROR
	BSF	GUI_FLAGS,COMMUNICATION_ERROR	;FLAG COMMUNICATION ERROR
PARSE_HOSTCMD_RESET
	NOP
        CLRF    SMHOST                  	;INITIALIZE FSM.
        CLRF    SMHOSTFLAGS             	;CLEAR FSM FLAGS.
        BSF	GUI_FLAGS,COM_IN_PROGRESS
        RETURN
PARSE_HOSTCMD_FSM
	BTFSC	GUI_FLAGS,GUI_TIME_OUT		;CHECK TIME OUT CONDITION FOR GUI
	BRA	PARSE_HOSTCMD_ERROR
	BTFSC	UARTINT_STATUS,UARTINT_RX_BUF_EMPTY	;IS RX BUFFER EMPTY
	RETURN					;YES - RETURN
	BCF	INTCON,PEIE
	CALL	UARTINT_GETCH			;READ RX BUFFER - READ RESULT IN WREG
	BSF	INTCON,PEIE
PARSE_HOSTCMD_EXECSTATE
	MOVWF	USARTBYTE
        MOVF    SMHOST, W               	;LOAD CURRENT FSM STATE
        RLNCF   WREG                    	;WORD ALIGN IT.
        ADDLW   0X0C                    	;OFFSET OF ACTUAL PCL WRITE FROM PCL
        ADDWF   PCL,W                   	;READ POINT
        MOVWF   TEMP2                  		;TEMP. STORE DATA
        MOVLW   0X00
        ADDWFC  PCLATH,F                	;ADJUST HIGHER BYTES OF PCL
        ADDWFC  PCLATU,F
        MOVF    TEMP2,W
        MOVWF   PCL                     	;EXECUTE IT
        BRA     PARSE_HOSTCMD_IDLE       	;SM_HOST_IDLE
        BRA     PARSE_HOSTCMD_STX_DLE    	;SM_HOST_STX_DLE
        BRA     PARSE_HOSTCMD_DLE_STX    	;SM_HOST_DLE_STX
        BRA     PARSE_HOSTCMD_LEN        	;SM_HOST_LEN
        BRA     PARSE_HOSTCMD_CMD        	;SM_HOST_CMD
        BRA     PARSE_HOSTCMD_DATA       	;SM_HOST_DATA
        BRA     PARSE_HOSTCMD_CHK        	;SM_HOST_CHK
        BRA     PARSE_HOSTCMD_DLE_ETX    	;SM_HOST_DLE
        BRA     PARSE_HOSTCMD_ETX        	;SM_HOST_ETX
        RETURN
PARSE_HOSTCMD_NEXTSTATE
        INCF    SMHOST                  	;ALL NEXT STATES ARE ASCENDING NUMERICAL
        BCF     SMHOSTFLAGS, SKIP_DLE   	;FORGET ABOUT PREVIOUS "DLE" STATE.
        BRA     PARSE_HOSTCMD_FSM       	;STATE VALUES.
PARSE_HOSTCMD_COMPARE
        CPFSEQ  USARTBYTE               	;COMPARE GIVEN VALUE WITH RECEIVED BYTE
	BRA	PARSE_HOSTCMD_ERROR		;ERROR IN COMMUNICATION - RETURN TO MAIN
        BRA     PARSE_HOSTCMD_NEXTSTATE 		;RECEIVED BYTE IS CORRECT - GOTO NEXT STATE.
PARSE_HOSTCMD_IDLE
        MOVLW   STX                     	;CHECK TO SEE IF THIS IS STX.
        BRA     PARSE_HOSTCMD_COMPARE
PARSE_HOSTCMD_STX_DLE
        MOVLW   DLE                     	;CHECK TO SEE IF THIS IS DLE.
        BRA     PARSE_HOSTCMD_COMPARE
PARSE_HOSTCMD_DLE_STX
        MOVLW   STX                     	;CHECK TO SEE IF THIS IS STX.
        BRA     PARSE_HOSTCMD_COMPARE
PARSE_HOSTCMD_LEN
        RCALL   DO_DLE_DESTUFF            	;DE-STUFF ANY STUFFED DLE
        BTFSC   WREG, 0H                	;DID WE DE-STUFF DLE ?
        BRA     PARSE_HOSTCMD_FSM       	;YES.  NEXT BYTE IS OUR DATA.
        MOVF    USARTBYTE, W            	;NO.  THIS IS THE DATA.
        MOVWF   HOSTDATALEN             	;SAVE IT.
        MOVWF   TEMPHOSTDATALEN         	;TEMP DATA LEN COUNTER.
        MOVWF   HOSTCHECKSUM            	;START CALCULATING CHECKSUM.
        BRA     PARSE_HOSTCMD_NEXTSTATE  	;GOTO NEXT STATE.
PARSE_HOSTCMD_CMD
        RCALL   DO_DLE_DESTUFF            	;DE-STUFF ANY STUFFED DLE
        BTFSC   WREG, 0H                	;DID WE DE-STUFF DLE ?
        BRA     PARSE_HOSTCMD_FSM       	;YES.  NEXT BYTE IS OUR DATA.
        MOVF    USARTBYTE, W            	;NO. THIS IS THE DATA.
        MOVWF   HOSTCMD                 	;SAVE IT.
        ADDWF   HOSTCHECKSUM,F          	;CALCULATE CHECKSUM.
	CALL	HOSTBUF_PUTCH			;SAVE DATA ON HOST BUFFER
        TSTFSZ  HOSTDATALEN             	;ANY DATA TO COME ?
        BRA     PARSE_HOSTCMD_NEXTSTATE  	;YES.  GOTO NEXT STATE
        INCF    SMHOST                  	;NO.  SKIP NEXT STATE
        BRA     PARSE_HOSTCMD_NEXTSTATE  	;AND GOTO SECOND NEXT STATE.
PARSE_HOSTCMD_DATA
        RCALL   DO_DLE_DESTUFF            	;DE-STUFF ANY STUFFED DLE
        BTFSC   WREG, 0H                	;DID WE DE-STUFF DLE ?
        BRA     PARSE_HOSTCMD_FSM       	;YES.  NEXT BYTE IS OUR DATA.
        BCF     SMHOSTFLAGS, SKIP_DLE   	;REMEMBER TO NOT SKIP ANY STUFFED DLE
                                        	;WE RECEIVE NEXT TIME.
                                        	;ONLY THIS STATE WILL STAY IN IT FOR
                                        	;MORE THAN ONE CHARACTER SO WE MUST
                                        	;CLEAR THIS FLAG HERE. FOR ALL OTHER
                                        	;STATES THIS FLAG IS CLEARED IN
                                        	;PARSE_HOSTCMD_NEXTSTATE.
        MOVF    USARTBYTE, W            	;NO.  THIS IS THE DATA.
        ADDWF   HOSTCHECKSUM,F          	;CALCULATE CHECKSUM
	CALL	HOSTBUF_PUTCH			;SAVE DATA ON HOST BUFFER
        DECFSZ  TEMPHOSTDATALEN         	;WAS THIS LAST BYTE ?
        BRA     PARSE_HOSTCMD_FSM       	;NO.  KEEP ACCEPTING NEW DATA.
        BRA     PARSE_HOSTCMD_NEXTSTATE  	;YES. GOTO NEXT STATE.
PARSE_HOSTCMD_CHK
        RCALL   DO_DLE_DESTUFF            	;DE-STUFF ANY STUFFED DLE
        BTFSC   WREG, 0H                	;DID WE DE-STUFF DLE ?
        BRA     PARSE_HOSTCMD_FSM       	;YES.  NEXT BYTE IS OUR DATA.
        MOVF    HOSTCHECKSUM, W         	;NO.  THIS IS THE DATA.
        CPFSEQ  USARTBYTE               	;IS CHECKSUM VALID ?
	BRA	PARSE_HOSTCMD_ERROR		;ERROR IN COMMUNICATION - RETURN TO MAIN
        BRA     PARSE_HOSTCMD_NEXTSTATE  	;YES. GOTO NEXT STATE
PARSE_HOSTCMD_DLE_ETX
        MOVLW   DLE                     	;CHECK TO SEE IF THIS DLE
        BRA     PARSE_HOSTCMD_COMPARE
PARSE_HOSTCMD_ETX
        MOVF    USARTBYTE, W
        XORLW   ETX                     	;CHECK FOR ETX
        BZ      PARSE_HOSTCMD_VALID      	;IF DLE, WE HAVE A VALID COMMAND
	BRA	PARSE_HOSTCMD_ERROR		;ERROR IN COMMUNICATION - RETURN TO MAIN
PARSE_HOSTCMD_VALID
        BCF	GUI_FLAGS,COM_IN_PROGRESS
	CLRF	TMR1_OF_COUNT_MSB
	CLRF	TMR1_OF_COUNT_LSB		;CLEAR TMR1 OF COUNT AS VALID COMMAND/DATA IS RECEIVED
        RETURN
DO_DLE_DESTUFF
        MOVF    USARTBYTE, W
        XORLW   DLE
        BZ      DLE_FOUND
        BTFSS   SMHOSTFLAGS, SKIP_DLE
        RETLW   00H
	BRA	PARSE_HOSTCMD_ERROR		;ERROR IN COMMUNICATION - RETURN TO MAIN
DLE_FOUND
        BTG     SMHOSTFLAGS, SKIP_DLE   
        BTFSS   SMHOSTFLAGS, SKIP_DLE
        RETLW   00H             
        RETLW   01H
;***************************************************************************
;ROUTINE TO SEND DATA TO HOST PC IN DEFINED SERIAL PROTOCOL FORMATE
;REFERENCE APP NOTE - AN819 FROM MICROCHIP
;***************************************************************************
SEND_HOSTDATA
        CLRF    SMHOST                  	;INITIALIZE HOST COMM PROTOCOL FSM
        CLRF    SMHOSTFLAGS
SEND_HOSTDATA_FSM
        BTFSC   UARTINT_STATUS,UARTINT_TX_BUF_FUL  ;IS TX BUFFER FULL?
        BRA     SEND_HOSTDATA_FSM        	;YES - CONTINUE WAITING...
SEND_HOSTDATA_EXECSTATE
        MOVF    SMHOST, W               	;LOAD CURRENT FSM STATE
        RLNCF   WREG                    	;WORD ALIGN IT.
        ADDLW   0X0C                    	;OFFSET OF ACTUAL PCL WRITE FROM PCL
        ADDWF   PCL,W                   	;READ POINT
        MOVWF   TEMP2                  		;TEMP. STORE DATA
        MOVLW   0X00
        ADDWFC  PCLATH,F                	;ADJUST HIGHER BYTES OF PCL
        ADDWFC  PCLATU,F
        MOVF    TEMP2,W
        MOVWF   PCL                     	;EXECUTE IT
        BRA     SEND_HOSTDATA_IDLE       	;SM_HOST_IDLE
        BRA     SEND_HOSTDATA_STX_DLE    	;SM_HOST_STX_DLE
        BRA     SEND_HOSTDATA_DLE_STX    	;SM_HOST_DLE_STX
        BRA     SEND_HOSTDATA_LEN        	;SM_HOST_LEN
        BRA     SEND_HOSTDATA_CMD        	;SM_HOST_CMD
        BRA     SEND_HOSTDATA_DATA       	;SM_HOST_DATA
        BRA     SEND_HOSTDATA_CHK        	;SM_HOST_CHK
        BRA     SEND_HOSTDATA_DLE_ETX    	;SM_HOST_DLE
        BRA     SEND_HOSTDATA_ETX        	;SM_HOST_ETX
        RETURN
SEND_HOSTDATA_IDLE
        MOVLW   STX                     	;LOAD STX
	CALL	UARTINT_PUTCH			;PUT TX CHARACTER IN TX BUFFER
        BRA     SEND_HOSTDATA_NEXTSTATE  	;GOTO NEXT STATE
SEND_HOSTDATA_STX_DLE
        MOVLW   DLE                     	;LOAD DLE
	CALL	UARTINT_PUTCH			;PUT TX CHARACTER IN TX BUFFER
        BRA     SEND_HOSTDATA_NEXTSTATE  	;GOTO NEXT STATE
SEND_HOSTDATA_DLE_STX
        MOVLW   STX                     	;LOAD STX
	CALL	UARTINT_PUTCH			;PUT TX CHARACTER IN TX BUFFER
        BRA     SEND_HOSTDATA_NEXTSTATE  	;GOTO NEXT STATE
SEND_HOSTDATA_LEN
        BTFSC   SMHOSTFLAGS, SKIP_DLE   	;CHECK FOR DLE ?
        BRA     SEND_HOSTDATA_LEN_SENDIT 	;NO. SEND IT AS IT IS.
        MOVF    RESPONSEDATALEN, W      	;YES. STUFF EXTRA DLE IF THERE IS ANY
        XORLW   DLE                     	;IS THIS DLE ?
        BZ      SEND_HOSTDATA_STUFFDLE
SEND_HOSTDATA_LEN_SENDIT
        MOVF    RESPONSEDATALEN, W
	CALL	UARTINT_PUTCH			;PUT TX CHARACTER IN TX BUFFER
        MOVFF   RESPONSEDATALEN,HOSTCHECKSUM    ;CALCULATE CHECKSUM
        BRA     SEND_HOSTDATA_NEXTSTATE
SEND_HOSTDATA_CMD
        BTFSC   SMHOSTFLAGS, SKIP_DLE   	;CHECK FOR DLE ?
        BRA     SEND_HOSTDATA_CMD_SENDIT	;NO. SEND IT AS IT IS.
        MOVF    RESPONSE, W             	;YES. STUFF EXTRA DLE IF THERE IS ANY
        XORLW   DLE                     	;IS THIS DLE ?
        BZ      SEND_HOSTDATA_STUFFDLE
SEND_HOSTDATA_CMD_SENDIT
        MOVF    RESPONSE, W
        ADDWF   HOSTCHECKSUM,F          	;CALCULATE CHECKSUM
	CALL	UARTINT_PUTCH			;PUT TX CHARACTER IN TX BUFFER
        MOVFF   RESPONSEDATALEN, TEMPHOSTDATALEN
        TSTFSZ  RESPONSEDATALEN         	;IS THERE ANY DATA TO SEND ?
        BRA     SEND_HOSTDATA_NEXTSTATE  	;YES. GOTO NEXT STATE.
        INCF    SMHOST                  	;NO. SKIP NEXT STATE.
        BRA     SEND_HOSTDATA_NEXTSTATE
SEND_HOSTDATA_DATA
        BTFSC   SMHOSTFLAGS, SKIP_DLE   	;CHECK FOR DLE ?
        BRA     SEND_HOSTDATA_DATA_SENDIT	;NO.  SEND IT AS IT IS.
	CALL	RESPONSEBUF_GETCH		;READ RESPONSE BUFFER FOR DATA TO BE TRANSMITTED
        XORLW   DLE                     	;IS THIS DLE ?
        BZ      SEND_HOSTDATA_STUFFDLE
SEND_HOSTDATA_DATA_SENDIT
        BCF     SMHOSTFLAGS, SKIP_DLE   	;REMEMBER TO NOT SKIP DLE FOR NEXT TIME.
	MOVF	TEMP5,W
        ADDWF   HOSTCHECKSUM,F          	;CALCULATE CHECKSUM.
	CALL	UARTINT_PUTCH			;PUT TX CHARACTER IN TX BUFFER
        DECFSZ  TEMPHOSTDATALEN         	;ALL DATA SENT ?
        BRA     SEND_HOSTDATA_FSM        	; NO. CONTINUE SENDING IT...
        BRA     SEND_HOSTDATA_NEXTSTATE  	;YES. GOTO NEXT STATE.
SEND_HOSTDATA_CHK
        BTFSC   SMHOSTFLAGS, SKIP_DLE   	;CHECK FOR DLE ?
	BRA     SEND_HOSTDATA_CHK_SENDIT 	;NO. SEND IT AS IT IS.
        MOVF    HOSTCHECKSUM, W         	;YES.STUFF EXTRA DLE IF THEREIS ANY.
        XORLW   DLE                     	;IS THIS DLE ?
        BZ      SEND_HOSTDATA_STUFFDLE   	;YES.  STUFF DLE.
SEND_HOSTDATA_CHK_SENDIT
        MOVF	HOSTCHECKSUM,W
        CALL	UARTINT_PUTCH			;SEND IT.
        BRA     SEND_HOSTDATA_NEXTSTATE  	;GOTO NEXT STATE.
SEND_HOSTDATA_DLE_ETX
        MOVLW   DLE
	CALL	UARTINT_PUTCH			;PUT TX CHARACTER IN TX BUFFER
        BRA     SEND_HOSTDATA_NEXTSTATE  	;GOTO NEXT STATE
SEND_HOSTDATA_ETX
        MOVLW   ETX
	CALL	UARTINT_PUTCH			;PUT TX CHARACTER IN TX BUFFER
        RETURN                         		;TRANSMISSION COMPLETE.
SEND_HOSTDATA_NEXTSTATE
        BCF     SMHOSTFLAGS, SKIP_DLE   	;FORGET ANY PREVIOUS "DLE" STATE.
        INCF    SMHOST                  	;LOAD NEXT STATE
        BRA     SEND_HOSTDATA_FSM        	;EXECUTE IT.
SEND_HOSTDATA_STUFFDLE
        MOVLW   DLE                     	;YES.  STUFF DLE.
	CALL	UARTINT_PUTCH			;PUT TX CHARACTER IN TX BUFFER
        BSF     SMHOSTFLAGS, SKIP_DLE   	;REMEMBER TO SKIP DLE NEXT TIME.
        BRA     SEND_HOSTDATA_FSM
;***************************************************************************
;ROUTINE TO SEND ACKNOWLEDGE TO HOST PC IN DEFINED SERIAL PROTOCOL FORMATE
;REFERENCE APP NOTE - AN819 FROM MICROCHIP
;***************************************************************************
ACKNOWLEDGE_HOST
        MOVLW   HOST_ACK
        MOVWF   RESPONSE                	;RESPONSE COMMAND - HOST ACKNOWLEDGEMENT
	MOVF	HOSTCMD,W
	CALL	RESPONSEBUF_PUTCH		;SAVE LAST RECEIVED HOST COMMAND AS DATA ON RESPONSE BUFFER
        MOVFF   RESPONSEDATALEN,RESPONSEDATA  	;SAVE RECEIVED RESEPONSEDATA LENGTH
        MOVLW   01H
        MOVWF   RESPONSEDATALEN
        CALL    SEND_HOSTDATA            	;SEND ACKNOWLEDGE
        MOVFF   RESPONSEDATA,RESPONSEDATALEN	;RESTORE RECD. RESPONSEDATA LENGTH
        RETURN
#ENDIF
;*************************************************************************************
;END OF FILE
;*************************************************************************************
        END
