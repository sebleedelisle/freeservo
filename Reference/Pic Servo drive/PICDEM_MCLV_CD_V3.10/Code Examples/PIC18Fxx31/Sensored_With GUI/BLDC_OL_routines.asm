;**************************************************************************************
;PROGRAM		:	BLDC OPEN LOOP SPEED CONTROL USING HALL SENSORS ON PICDEM MC LV BOARD (SUB ROUTINES)
;MICROCONTROLLER	:	PIC18FXX31
;CRYSTAL FREQUENCY	:	5MHZ (X4 PLL)
;**************************************************************************************
;AUTHOR			:	PADMARAJA YEDAMALE
;			:	RAKESH PAREKH
;DATE			:	01-APR-2005
;VERSION		:	V1.0
;**************************************************************************************
;*
;* Software License Agreement
;*
;* The software supplied herewith by Microchip Technology Incorporated
;* (the “Company”) for its PICmicro® Microcontroller is intended and
;* supplied to you, the Company’s customer, for use solely and
;* exclusively on Microchip PICmicro Microcontroller products. The
;* software is owned by the Company and/or its supplier, and is
;* protected under applicable copyright laws. All rights are reserved.
;* Any use in violation of the foregoing restrictions may subject the
;* user to criminal sanctions under applicable laws, as well as to
;* civil liability for the breach of the terms and conditions of this
;* license.
;*
;* THIS SOFTWARE IS PROVIDED IN AN “AS IS” CONDITION. NO WARRANTIES,
;* WHETHER EXPRESS, IMPLIED OR STATUTORY, INCLUDING, BUT NOT LIMITED
;* TO, IMPLIED WARRANTIES OF MERCHANTABILITY AND FITNESS FOR A
;* PARTICULAR PURPOSE APPLY TO THIS SOFTWARE. THE COMPANY SHALL NOT,
;* IN ANY CIRCUMSTANCES, BE LIABLE FOR SPECIAL, INCIDENTAL OR
;* CONSEQUENTIAL DAMAGES, FOR ANY REASON WHATSOEVER.

;**************************************************************************************
;THIS FILE CONTAINS VARIOUS ROUTINES TO IMPLEMENT BLDC OPEN LOOP CONTROL
;**************************************************************************************

	#INCLUDE <P18F2431.INC>
	#INCLUDE <INTERFACEBLDCCONSTANT.INC>
	#INCLUDE <INTERFACEBLDCVAR.INC>

	GLOBAL	PROCESS_KEY_PRESSED,UPDATE_PWM,FAULT_CHECK,INIT_PWM
	GLOBAL	SET_DIRECTION_AT_POR,CONFIGURE_PWM
	GLOBAL	INIT_TMR1,INIT_ADC,READ_SYSTEM_PARAMETERS,INIT_PORTS,INIT_MOTION_FEEDBACK_MODULE
	GLOBAL	ISR_HIGH,ISR_LOW,CLEAR_ALL_RAM,INIT_INTERRUPT,LOAD_SEQUENCE_TABLE,CLEAR_ALL_LED
	GLOBAL	STOP_MOTOR
	
#IFDEF  RAMP
	GLOBAL	RAMP_SPEED
#ENDIF

#IF ((ACTIVE_MODE == 0X01) || (ACTIVE_MODE == 0X03))
	GLOBAL	KEY_CHECK,CONVERT_MANUAL_COUNT_TO_RPS
#ENDIF

#IF ((ACTIVE_MODE == 0X01) || (ACTIVE_MODE == 0X02))
	GLOBAL	INIT_EUSART,PROCESS_RUN_CMD,PROCESS_STOP_CMD,REINITIALIZE_BUFFERS,PROCESS_DOWNLOAD_PARAMETERS_CMD
	GLOBAL	PROCESS_SEND_PARAMETERS_CMD,PROCESS_SET_DIRECTION_CMD
	EXTERN	HOSTBUF_GETCH,SEND_HOSTDATA,RESPONSEBUF_PUTCH,RESPONSE
#ENDIF

ROUTINES    CODE
;*************************************************************************************
;ISR FOR HIGH PRIORITY INTERRUPT
;*************************************************************************************
ISR_HIGH
	BANKSEL	GUI_FLAGS
	MOVFF	FSR1L,ISR_FSR1L
	MOVFF	FSR1H,ISR_FSR1H
	BTFSC	PIR1,ADIF
	BRA	ISR_ADC
	BTFSC	PIR3,IC1IF
	BRA	ISR_HALL_A
	BTFSC	PIR3,IC2QEIF
	BRA	ISR_HALL_B
	BTFSC	PIR3,IC3DRIF
	BRA	ISR_HALL_C
ISR_HIGH_CONTEXT_RETRIEVE
	MOVFF	ISR_FSR1L,FSR1L
	MOVFF	ISR_FSR1H,FSR1H
	RETFIE	FAST					;CONTEXT RETRIEVING AND ENABLING HIGH PRIORITY INTERRUPTS
;*************************************************************************************
;ISR FOR LOW PRIORITY INTERRUPT
;*************************************************************************************
ISR_LOW
	MOVWF	ISR_WREG				;CONTEXT SAVING
	MOVFF	BSR,ISR_BSR
	MOVFF	STATUS,ISR_STATUS
#IF ((ACTIVE_MODE == 0X01) || (ACTIVE_MODE == 0X02))
CHECK_RX_INT
	BTFSC	PIR1,RCIF				;IS IT RECEIVE INTERRUPT?
	BRA	ISR_RX					;YES - JUMP TO RX ISR
#ENDIF
CHECK_TMR1_INT	
	BTFSC	PIR1,TMR1IF				;IS IT TMR1 OVER FLOW INT?
	BRA	ISR_TMR1				;YES - JUMP TO TMR1 ISR
#IF ((ACTIVE_MODE == 0X01) || (ACTIVE_MODE == 0X02))
CHECK_TX_INT				
	BTFSC	PIR1,TXIF				;IS IT TRANSMIT INTERRUPT?
	BRA	ISR_TX					;YES - JUMP TO TX ISR
#ENDIF
ISR_LOW_CONTEXT_RETRIEVE
	MOVFF	ISR_BSR,BSR				;CONTEXT RETRIEVING
	MOVF	ISR_WREG,W
	MOVFF	ISR_STATUS,STATUS
	RETFIE						;ENABLING LOW PRIORITY INTERRUPTS
;*************************************************************************************
;TRANSMIT INTERRUPT ROUTINE
;*************************************************************************************
#IF ((ACTIVE_MODE == 0X01) || (ACTIVE_MODE == 0X02))
ISR_TX
	BTFSS	PIE1,TXIE
	BRA	ISR_LOW_CONTEXT_RETRIEVE
	BANKSEL	UARTINT_STATUS				;CLEAR UARTINT_TX_BUF_FUL ERROR BIT AS DATA
	BCF	UARTINT_STATUS,UARTINT_TX_BUF_FUL	;IS TRANSMITTED SO BUFFER HAS SPACE FOR NEW DATA
	DECFSZ	UARTINT_TX_BUF_DATACNT ,F		;CHECK ANY MORE DATA TO TRANSMIT
	BRA	TRANSMITDATA				;YES - TRANSMIT NEW DATA
	BCF	PIE1,TXIE				;DISABLE TX INTERRUPT UNTIL WE HAVE MORE DATA TO TRANSMIT
	BRA	ISR_LOW_CONTEXT_RETRIEVE
TRANSMITDATA
	MOVFF	FSR0H,ISR_FSR0H				;STORE FSR0 BEFORE MODIFICATION
	MOVFF	FSR0L,ISR_FSR0L
	LFSR	FSR0, UARTINT_TX_BUFFER
	MOVF	UARTINT_TX_BUF_RDPTR,W
	MOVFF	PLUSW0, TXREG
	INCF	UARTINT_TX_BUF_RDPTR,F			;INCREMENT READ POINTER
	MOVLW	UARTINT_TX_BUFFER_SIZE			;IF READ POINTER HAS REACHED THE MAXIMUM
	XORWF	UARTINT_TX_BUF_RDPTR,W			;VALUE THEN RESET IT FOR ROLL-OVER
	BTFSC	STATUS,Z
	CLRF	UARTINT_TX_BUF_RDPTR
	MOVFF	ISR_FSR0H,FSR0H				;RETRIEVE FSR0 BEFORE RETURN
	MOVFF	ISR_FSR0L,FSR0L
	BRA	ISR_LOW_CONTEXT_RETRIEVE
;*************************************************************************************
;RECEIVE INTERRUPT ROUTINE
;*************************************************************************************
ISR_RX
	BTFSS	PIE1,RCIE
	BRA	CHECK_TMR1_INT
	BANKSEL	UARTINT_STATUS
	MOVFF	RCREG,TEMP1
	MOVLW	0X06					;MASK OUT UNWANTED BITS
	ANDWF	RCSTA,W					;CHECK FOR ERRORS
	BNZ	RCVERROR				;FOUND ERROR, FLAG IT
	BTFSC	UARTINT_STATUS,UARTINT_RX_BUF_OF	;CHECK FOR UARTINT_RX_BUF_OF BIT
	BRA	ISR_LOW_CONTEXT_RETRIEVE		;IF BUFFER FULL THEN RETURN TO CHECK OTHER INTERRUPT
	BTFSS	UARTINT_STATUS,UARTINT_RX_BUF_FUL	;CHECK FOR UARTINT_RX_BUF_FUL BIT
	BRA	APPENDRXBUFFER				;IF BUFFER FULL THEN SET RX BUFFER
	BSF	UARTINT_STATUS,UARTINT_RX_BUF_OF	;OVER FLOW FLAG TO INDICATE THAT
	BRA	ISR_LOW_CONTEXT_RETRIEVE		;DATA IS MISSED.
APPENDRXBUFFER
	MOVFF	FSR0H,ISR_FSR0H				;STORE FSR0 BEFORE MODIFICATION
	MOVFF	FSR0L,ISR_FSR0L
	LFSR	FSR0, UARTINT_RX_BUFFER
	BCF	UARTINT_STATUS,UARTINT_RX_BUF_EMPTY	;INDICATE RX BUF NOT EMPTY
	MOVF	UARTINT_RX_BUF_WRPTR,W			;POINT TO PREVIOUS LOCATION
	MOVFF	TEMP1,PLUSW0				;COPY THE DATA INTO FIFO BUFFER
	INCF	UARTINT_RX_BUF_WRPTR,F			;INCREMENT WRITE POINTER
	MOVLW	UARTINT_RX_BUFFER_SIZE			;IF WRITE POINTER HAS REACHED THE MAXIMUM
	XORWF	UARTINT_RX_BUF_WRPTR,W			;VALUE THEN RESET IT FOR ROLL-OVER
	BTFSC	STATUS,Z
	CLRF	UARTINT_RX_BUF_WRPTR
	INCF	UARTINT_RX_BUF_DATACNT,F		;DECREMENT UARTINT_RX_BUFFER DATA SIZE
	MOVFF	ISR_FSR0H,FSR0H				;RETRIEVE FSR0 BRFORE RETURN
	MOVFF	ISR_FSR0L,FSR0L
	MOVLW	UARTINT_RX_BUFFER_SIZE			;IF BUFFER HAS REACHED THE MAXIMUM
	XORWF	UARTINT_RX_BUF_DATACNT,W		;VALUE THEN SET THE FLAG FOR FULL
	BZ	RXBUFFULL
	BRA	ISR_LOW_CONTEXT_RETRIEVE
RXBUFFULL
	BSF	UARTINT_STATUS,UARTINT_RX_BUF_FUL	;IN UARTINT_STATUS
	BRA	ISR_LOW_CONTEXT_RETRIEVE
RCVERROR
	BCF	RCSTA,CREN				;CLEAR RECIEVER STATUS
	NOP
	BSF	RCSTA,CREN
	BSF	UARTINT_STATUS,UARTINT_RX_ERROR		;SET DATA ERROR FLAG
	BRA	ISR_LOW_CONTEXT_RETRIEVE
#ENDIF
;*************************************************************************************
;TMR1 ISR
;*************************************************************************************
ISR_TMR1
	BANKSEL	GUI_FLAGS
	BCF	PIR1,TMR1IF				;CLEAR TMR1 INT FLAG
	MOVLW	TMR1H_COUNT				;RELOAD TMR1 FOR 100MSEC OVER FLOW
	MOVWF	TMR1H
	MOVLW	TMR1L_COUNT
	MOVWF	TMR1L
	INCF	RAMP_COUNT,F
	BSF	BLDC_FLAGS_1,TMR1_OF
#IF ((ACTIVE_MODE == 0X01) || (ACTIVE_MODE == 0X02))
	BTFSS	GUI_FLAGS,GUI_ON
	BRA	TOGGLE_GPR_LED
	INCFSZ	TMR1_OF_COUNT_LSB,F			;INCREMENT TMR1 OVER FLOW LSB COUNT
	BRA	ISR_LOW_CONTEXT_RETRIEVE
	INCF	TMR1_OF_COUNT_MSB,F
	BTFSS	TMR1_OF_COUNT_MSB,3
	BRA	ISR_LOW_CONTEXT_RETRIEVE
	CLRF	TMR1_OF_COUNT_LSB
	CLRF	TMR1_OF_COUNT_MSB
	BSF	GUI_FLAGS,GUI_TIME_OUT
	BRA	ISR_LOW_CONTEXT_RETRIEVE
#ENDIF
TOGGLE_GPR_LED
#IF ((ACTIVE_MODE == 0X01) || (ACTIVE_MODE == 0X02))
	BTFSS	GUI_FLAGS,GUI_CONTROL_1ST_TIME		;WAS GUI ON EARLIER?
	BRA	ISR_LOW_CONTEXT_RETRIEVE		;YES - BACK TO MAIN, DO NOT TOGGLE LED
	BTFSC	GUI_FLAGS,GUI_ON			;IS GUI ON PRESENTLY?
	BRA	ISR_LOW_CONTEXT_RETRIEVE		;YES - BACK TO MAIN, DO NOT TOGGLE LED
#ENDIF
#IF ((ACTIVE_MODE == 0X01) || (ACTIVE_MODE == 0X03))
	BTFSS	BLDC_FLAGS_1,HW_CONTOL_1ST_TIME		;WAS MANUAL MODE ON EARLIER?
	BRA	ISR_LOW_CONTEXT_RETRIEVE		;YES - BACK TO MAIN, DO NOT TOGGLE LED
#ENDIF
	INCFSZ	TEMP_LAST_ADC,F
	BRA	ISR_LOW_CONTEXT_RETRIEVE		;YES - BACK TO MAIN
	MOVF	LAST_ADC,W
	IORLW	MASKBYTE
	MOVWF	TEMP_LAST_ADC				;SAVE IT
	BTG	PORTC,LED1				;TURN ON ALL GPR LED
	BTG	PORTC,LED2
	BTG	PORTC,LED3
	BRA	ISR_LOW_CONTEXT_RETRIEVE		;YES - BACK TO MAIN
;*************************************************************************************
;ADC ISR
;*************************************************************************************
ISR_ADC
	MOVFF	ADRESH,CURRENT_UH			;SAMPLE A = R PHASE CURRENT OR DC CURRENT
	MOVFF	ADRESH,REQD_SPEED_REFH			;SAMPLE B = SPEED (POT READING)
	SETF    JUNCTION_TEMPH
        MOVFF   CURRENT_UH,CURRENT_VH
        MOVFF   CURRENT_UH,CURRENT_WH

	MOVFF	REQD_SPEED_REFH,LAST_ADC
	BSF	BLDC_FLAGS,CALC_PWM
	BCF	PIR1,ADIF				;ADIF FLAG IS CLEARED FOR NEXT INTERRUPT	   
	BSF	ADCON0,GO				;SET GO BIT FOR ADC CONVERSION START
	BTFSS	GUI_FLAGS,GUI_ON
	BRA	ISR_HIGH_CONTEXT_RETRIEVE
	MOVFF	PARAMETER_BUFFER+LOC_REQD_SPEED_RPS,REQD_SPEED_RPS
	BRA	ISR_HIGH_CONTEXT_RETRIEVE
;*************************************************************************************
;HALL SENSOR A ISR
;*************************************************************************************
ISR_HALL_A
#IF ((ACTIVE_MODE == 0X01) || (ACTIVE_MODE == 0X02))
	MOVFF	CAP1BUFL,PARAMETER_BUFFER+LOC_CAPBUF_CNT_LSB
	MOVFF	CAP1BUFH,PARAMETER_BUFFER+LOC_CAPBUF_CNT_MSB	;READ SPEED, MODIFIED BY PY
#ENDIF
	CALL	UPDATE_SEQUENCE
	BCF	PIR3,IC1IF
	BTFSC	FLT_FLAGS_1,FAULT
	BRA	ISR_HIGH_CONTEXT_RETRIEVE
	BCF	PORTC,LED1
	btfsc	PORTA,2
	BSF	PORTC,LED1
	BRA	ISR_HIGH_CONTEXT_RETRIEVE
;*************************************************************************************
;HALL SENSOR B ISR
;*************************************************************************************
ISR_HALL_B
#IF ((ACTIVE_MODE == 0X01) || (ACTIVE_MODE == 0X02))
	MOVFF	CAP2BUFL,PARAMETER_BUFFER+LOC_CAPBUF_CNT_LSB
	MOVFF	CAP2BUFH,PARAMETER_BUFFER+LOC_CAPBUF_CNT_MSB	;READ SPEED, MODIFIED BY PY
#ENDIF
	CALL	UPDATE_SEQUENCE
	BCF	PIR3,IC2QEIF
	BTFSC	FLT_FLAGS_1,FAULT
	BRA	ISR_HIGH_CONTEXT_RETRIEVE
	BCF	PORTC,LED2
	btfsc	PORTA,3
	BSF	PORTC,LED2
	BRA	ISR_HIGH_CONTEXT_RETRIEVE
;*************************************************************************************
;HALL SENSOR C ISR
;*************************************************************************************
ISR_HALL_C
#IF ((ACTIVE_MODE == 0X01) || (ACTIVE_MODE == 0X02))
	MOVFF	CAP3BUFL,PARAMETER_BUFFER+LOC_CAPBUF_CNT_LSB
	MOVFF	CAP3BUFH,PARAMETER_BUFFER+LOC_CAPBUF_CNT_MSB	;READ SPEED, MODIFIED BY PY
#ENDIF
	CALL	UPDATE_SEQUENCE
	BCF	PIR3,IC3DRIF
	BTFSC	FLT_FLAGS_1,FAULT
	BRA	ISR_HIGH_CONTEXT_RETRIEVE
	BCF	PORTC,LED3
	btfsc	PORTA,4
	BSF	PORTC,LED3
	BRA	ISR_HIGH_CONTEXT_RETRIEVE
;*************************************************************************************
;ROUTINE FOR GENERATING OUTPUT PATTERN DEPENDING ON HALL SENSOR STATUS
;*************************************************************************************
UPDATE_SEQUENCE
	BTFSS	BLDC_FLAGS_1,FWD_REV
	BRA	ITS_REVERSE
	LFSR	FSR1,POSITION_TABLE_FWD
	BRA	PICK_FROM_TABLE
ITS_REVERSE
	LFSR	FSR1,POSITION_TABLE_REV
PICK_FROM_TABLE
	MOVF	PORTA,W
	ANDLW	0X1C					;IC1/IC2/IC3
	RRNCF	WREG,W
	RRNCF	WREG,W
	MOVF	PLUSW1,W
	MOVWF	OVDCOND
	RETURN
;*************************************************************************************
;ROUTINE TO PROCESS LAST KEY PRESS ACTION
;*************************************************************************************
PROCESS_KEY_PRESSED
	BTFSS	BLDC_FLAGS_1,KEY_PRESSED
	RETURN
	BTFSS	BLDC_FLAGS_1,KEY_RS
	BRA	CHECK_FWD_REV
	BTFSS	BLDC_FLAGS_1,RUN_STOP
	BRA	STOP_MOTOR_NOW
	CALL	RUN_MOTOR_AGAIN
	CALL	CLEAR_ALL_LED
	BCF	BLDC_FLAGS_1,KEY_PRESSED
	BCF	BLDC_FLAGS_1,KEY_RS
	RETURN
STOP_MOTOR_NOW
	CALL	STOP_MOTOR				;STOP MOTOR
	BCF	BLDC_FLAGS_1,KEY_PRESSED
	BCF	BLDC_FLAGS_1,KEY_RS
	RETURN
CHECK_FWD_REV
	BTFSS	BLDC_FLAGS_1,KEY_FR
	RETURN
	CALL	STOP_MOTOR
	MOVLW	CHANGE_OVER_DELAY
	MOVWF	COUNTER2
WAIT_FOR_MOTOR_STOP
	CALL	DELAY
	DECFSZ	COUNTER2,F
	BRA	WAIT_FOR_MOTOR_STOP
	CALL	RUN_MOTOR_AGAIN
	BCF	BLDC_FLAGS_1,KEY_PRESSED
	BCF	BLDC_FLAGS_1,KEY_FR
	BTG	BLDC_FLAGS_1,FWD_REV
	RETURN
;*************************************************************************************
;ROUTINE TO STOP MOTOR
;*************************************************************************************
#IF ((ACTIVE_MODE == 0X01) || (ACTIVE_MODE == 0X02))
PROCESS_STOP_CMD
	BSF	BLDC_FLAGS_1,KEY_RS
	BCF	BLDC_FLAGS_1,DEBOUNCE
	BSF	BLDC_FLAGS_1,KEY_PRESSED
	BCF	BLDC_FLAGS_1,RUN_STOP
	RETURN
;*************************************************************************************
;ROUTINE TO RUN MOTOR
;*************************************************************************************
PROCESS_RUN_CMD
	BTFSC	BLDC_FLAGS_1,RUN_STOP
	BRA	READ_SPEED_INFO
	BSF	BLDC_FLAGS_1,KEY_RS
	BCF	BLDC_FLAGS_1,DEBOUNCE
	BSF	BLDC_FLAGS_1,KEY_PRESSED
	BSF	BLDC_FLAGS_1,RUN_STOP
READ_SPEED_INFO
	CALL    HOSTBUF_GETCH
	MOVFF   WREG,PARAMETER_BUFFER+LOC_REQD_SPEED_RPM_LSB
	CALL    HOSTBUF_GETCH
	MOVFF   WREG,PARAMETER_BUFFER+LOC_REQD_SPEED_RPM_MSB
	CALL    HOSTBUF_GETCH
	MOVFF   WREG,PARAMETER_BUFFER+LOC_REQD_SPEED_RPS
	RETURN
;*************************************************************************************
;ROUTINE TO SET MOTOR DIRECTION
;*************************************************************************************
PROCESS_SET_DIRECTION_CMD
	BSF	BLDC_FLAGS_1,KEY_FR
	BCF	BLDC_FLAGS_1,DEBOUNCE
	BSF	BLDC_FLAGS_1,KEY_PRESSED
	RETURN
#ENDIF
;*************************************************************************************
;ROUTINE TO SET MOTOR DIRECTION AT POR
;*************************************************************************************
SET_DIRECTION_AT_POR
	MOVLW	DIRECTION_AT_POR
	BTFSC	WREG,0
	BRA	SET_POR_DIRECTION_FWD
	BCF	BLDC_FLAGS_1,FWD_REV
	RETURN
SET_POR_DIRECTION_FWD
	BSF	BLDC_FLAGS_1,FWD_REV
	RETURN
;*************************************************************************************
;ROUTINE TO SEND MOTOR PARAMETERS
;*************************************************************************************
#IF ((ACTIVE_MODE == 0X01) || (ACTIVE_MODE == 0X02))
PROCESS_SEND_PARAMETERS_CMD
	MOVF	BLDC_FLAGS_1,W					;DIRECTION BYTE
	ANDLW	0X01
	CALL	RESPONSEBUF_PUTCH
	MOVF	CURRENT_UH,W
	CALL	RESPONSEBUF_PUTCH
	MOVF	CURRENT_VH,W
	CALL	RESPONSEBUF_PUTCH
	MOVF	CURRENT_WH,W
	CALL	RESPONSEBUF_PUTCH
	MOVF	JUNCTION_TEMPH,W
	CALL	RESPONSEBUF_PUTCH
	MOVFF	PARAMETER_BUFFER+LOC_CAPBUF_CNT_LSB,WREG
	BTFSS	BLDC_FLAGS_1,RUN_STOP
	CLRF	WREG
	CALL	RESPONSEBUF_PUTCH
	MOVFF	PARAMETER_BUFFER+LOC_CAPBUF_CNT_MSB,WREG
	BTFSS	BLDC_FLAGS_1,RUN_STOP
	CLRF	WREG
	CALL	RESPONSEBUF_PUTCH
	MOVF	FLT_FLAGS,W
	CALL	RESPONSEBUF_PUTCH
	MOVFF	PARAMETER_BUFFER+LOC_FUTURE_USE_0,WREG
	CALL	RESPONSEBUF_PUTCH
	MOVFF	PARAMETER_BUFFER+LOC_FUTURE_USE_1,WREG
	CALL	RESPONSEBUF_PUTCH
	MOVFF	PARAMETER_BUFFER+LOC_FUTURE_USE_2,WREG
	CALL	RESPONSEBUF_PUTCH
	MOVFF	PARAMETER_BUFFER+LOC_FUTURE_USE_3,WREG
	CALL	RESPONSEBUF_PUTCH
	MOVLW	0X0C						;SET RESPONSE DATA LENGTH D'12'
	MOVWF	RESPONSEDATALEN
	MOVLW	COMMAND_ASK_DATA
	MOVWF	RESPONSE					;SET RESPONSE COMMAND 'FIRMWARE DATA'
	CALL	SEND_HOSTDATA					;SEND ALL DATA TO GUI
	RETURN
;*************************************************************************************
;ROUTINE TO SET SYSTEM PARAMETERS
;*************************************************************************************
PROCESS_DOWNLOAD_PARAMETERS_CMD
	LFSR	FSR0,PARAMETER_BUFFER				;LOAD PARAMETER_BUFFER BASE ADDRESS
	MOVFF	HOSTDATALEN,TEMPHOSTDATALEN			;TEMP DATA LEN COUNTER.
REPEAT_SYSTEM_PARAMETER_SAVE
	CALL	HOSTBUF_GETCH					;READ ALL RECEIVED DATA ONE BY ONE
	MOVWF	POSTINC0					;AND STORE THEM ON SYSTEM PARAMETER BUFFER
	DECFSZ	TEMPHOSTDATALEN					;DID ALL RECEIVED DATA SAVE?
	BRA	REPEAT_SYSTEM_PARAMETER_SAVE			;NO - CONTINUE SAVE OPERATION
	LFSR	FSR0,PARAMETER_BUFFER				;LOAD PARAMETER_BUFFER BASE ADDRESS
	CLRF	EEADR						;POINT ADDRESS REG. TO STARTING ADDRESS
WRITE_TO_EEPROM
	BCF	INTCON,GIE					;DISABLE ALL INTTERUPTS
	BCF	INTCON,GIE
	BCF	EECON1,CFGS					;ACCESS FLASH/EEPROM MEMORY
	BCF	EECON1,EEPGD					;ACCESS EEPROM MEMORY
	MOVFF	HOSTDATALEN,TEMPHOSTDATALEN			;TEMP DATA LEN COUNTER.
	BSF	EECON1,WREN					;WRITE ENABLE
REPEAT_DATA_WRITE
	MOVF	POSTINC0,W					;READ VALUE FROM PARAMETER BUFFER
	MOVWF	EEDATA
	MOVLW	0X55						;WRITE SEQUENCE
	MOVWF	EECON2
	MOVLW	0XAA
	MOVWF	EECON2
	BSF	EECON1,WR					;WRITE TO DATA EEPROM
	BTFSC	EECON1,WR					;WAIT HERE TILL WRITE IS OVER
	BRA	$-2
	INCF	EEADR
	DECFSZ	TEMPHOSTDATALEN					;ALL RECEIVED WRITTEN TO EEPROM?
	BRA	REPEAT_DATA_WRITE				;NO WRITE NEXT DATA TO EEPROM
	BCF	EECON1,WREN					;ALL WRITE OVER - DISABLE FURTHER WRITE
	CLRF	TMR1_OF_COUNT_LSB
	CLRF	TMR1_OF_COUNT_MSB
	BSF	INTCON,GIE					;REENABLE ALL INTERRUPTS
	RETURN
;*************************************************************************************
;ROUTINE TO REINITIALIZE AUTO BAUD DETECT AND RX/HOST BUFFERS
;*************************************************************************************
REINITIALIZE_BUFFERS
	CLRF    UARTINT_STATUS
	CLRF    UARTINT_TX_BUF_DATACNT
	CLRF    UARTINT_TX_BUF_WRPTR
	CLRF    UARTINT_TX_BUF_RDPTR
	CLRF    UARTINT_RX_BUF_DATACNT
	CLRF    UARTINT_RX_BUF_WRPTR
	CLRF    UARTINT_RX_BUF_RDPTR
	CLRF    HOSTRESPONSE_BUF_STATUS
	CLRF    HOST_BUF_DATACNT
	CLRF    HOST_BUF_WRPTR
	CLRF    HOST_BUF_RDPTR
	CLRF    RESPONSE_BUF_DATACNT
	CLRF    RESPONSE_BUF_WRPTR
	CLRF    RESPONSE_BUF_RDPTR
	BSF	HOSTRESPONSE_BUF_STATUS,HOST_BUF_EMPTY
	BSF	HOSTRESPONSE_BUF_STATUS,RESPONSE_BUF_EMPTY
	BSF	UARTINT_STATUS,UARTINT_RX_BUF_EMPTY
	BCF	GUI_FLAGS,GUI_TIME_OUT
	BCF	GUI_FLAGS,COM_IN_PROGRESS
	BCF	GUI_FLAGS,COMMUNICATION_ERROR
	CLRF    TMR1_OF_COUNT_LSB
	CLRF    TMR1_OF_COUNT_MSB
	RETURN
#ENDIF
;*******************************************************************************
;THIS ROUTINE STOPS THE MOTOR BY DRIVING THE PWMS TO 0% DUTY CYCLE.
;*******************************************************************************
STOP_MOTOR
	CLRF    OVDCOND
	CLRF    PDC0H
	CLRF    PDC1H
	CLRF    PDC2H
	CLRF    PDC0L
	CLRF    PDC1L
	CLRF    PDC2L
	CLRF    REQD_SPEED_REFH
	CLRF    REQD_SPEED_RPS
	CLRF    ACTUAL_SPEED_RPS
	RETURN
;*******************************************************************************
;THIS ROUTINE STARTS MOTOR FROM PREVIOUS STOP WITH MOTOR PARAMETERS INITIALIZED
;*******************************************************************************
RUN_MOTOR_AGAIN
	CLRF    REQD_SPEED_REFH
	CLRF    REQD_SPEED_RPS
	CLRF    ACTUAL_SPEED_RPS
	CLRF    CURRENT_UH
	CLRF    CURRENT_VH
	CLRF    CURRENT_WH
	SETF    JUNCTION_TEMPH
	CLRF    BLDC_FLAGS
	MOVLW   0X03					;FLTA AND FLTB INITIALIZED TO CYCLE BY CYCLE MODE
	MOVWF   FLTCONFIG
	CLRF    FLT_FLAGS
	CLRF    FLT_FLAGS_1
	CLRF	FAULTA_COUNT
	CLRF	FAULTB_COUNT
	CALL    UPDATE_SEQUENCE
	RETURN
;*******************************************************************************
;ROUTINE TO UPDATE PWM DUTY CYCLE BASED ON SPEED COMMAND
;*******************************************************************************
UPDATE_PWM
	BCF	BLDC_FLAGS,CALC_PWM
	BTFSS   BLDC_FLAGS_1,RUN_STOP
	RETURN
	BTFSC	FLT_FLAGS_1,FAULT
	RETURN
	MOVFF   PARAMETER_BUFFER+LOC_RPS_PWM_CONSTANT_LSB,WREG
	MULWF   ACTUAL_SPEED_RPS
	MOVFF   PRODL,PDC_TEMPL
	MOVFF   PRODH,PDC_TEMPH
	MOVFF   PARAMETER_BUFFER+LOC_RPS_PWM_CONSTANT_MSB,WREG
	MULWF   ACTUAL_SPEED_RPS
	MOVF    PRODL,W
	ADDWF   PDC_TEMPH,F
LOAD_DC_REGISTERS
	BSF	PWMCON1,UDIS    ;DISABLE PWM BUFFER UPDATE
	MOVF    PDC_TEMPH,W
	MOVWF   PDC0H
	MOVWF   PDC1H
	MOVWF   PDC2H
	MOVF    PDC_TEMPL,W
	MOVWF   PDC0L
	MOVWF   PDC1L
	MOVWF   PDC2L
	BCF	PWMCON1,UDIS    ;ENABLE PWM BUFFER UPDATE
	RETURN
;*************************************************************************************
;EUSART INITIALIZATION ROUTINE
;*************************************************************************************
#IF ((ACTIVE_MODE == 0X01) || (ACTIVE_MODE == 0X02))
INIT_EUSART
	CLRF    TXREG       				;CLEAR TRANSMIT REGISTER
	CLRF    RCREG       				;CLEAR RECEIVE REGISTER
	CLRF    SPBRGH      				;CLEAR BAUD RATE GENERATOR HIGH BYTE
	CLRF    SPBRG       				;CLEAR BAUD RATE GENERATOR LOW BYTE
	CLRF    TXSTA       				;CLEAR TX STATUS REGISTER
	CLRF    RCSTA       				;CLEAR RX STATUS REGISTER
	CLRF    BAUDCTL     				;CLEAR BAUD CONTROL REGISTER
	BSF	RCSTA,SPEN	 	 		;SERIAL PORT ENABLED
	BSF	RCSTA,CREN				;ENABLE CONITNUOUS RECEIVE
	BSF	TXSTA,TXEN				;TX ENABLED
	BSF	TXSTA,BRGH
	BSF	BAUDCTL,ABDEN   			;ENABLE AUTO BAUD DETECT
	BSF	HOSTRESPONSE_BUF_STATUS,HOST_BUF_EMPTY
	BSF	HOSTRESPONSE_BUF_STATUS,RESPONSE_BUF_EMPTY
	BSF	UARTINT_STATUS,UARTINT_RX_BUF_EMPTY
	RETURN
#ENDIF
;*************************************************************************************
;ADC INITIALIZATION ROUTINE
;*************************************************************************************
INIT_ADC
	MOVLW   0X11
	MOVWF   ADCON0      ;SINGLE SHOT 2 CH SEQUENTIAL
	MOVLW   0X00
	MOVWF   ADCHS       ;AN0 AND AN1 SELECTED FOR CONVERSION
	MOVLW   0X03
	MOVWF   ANSEL0      ;RA0 AND RA1 SELECTED AS ANALOG INPUT
	MOVLW   0X40
	MOVWF   ADCON3      ;ALL TRIGGER SOURCE DISABLED, INTERRUPT AT 2ND AND 4TH WRITE

	MOVLW   0X10
	MOVWF   ADCON1      ;FIFO ENABLED, INTERNAL VREF+ AND VREF-
	MOVLW   0X7A
	MOVWF   ADCON2      ;LEFT JUSTIFIED, 64TAD ACQ. TIME AND CLOCK FOSC/32
	CLRF    ADRESL      ;CLEAR ADC RESULT REGISTERS
	CLRF    ADRESH
	RETURN
;*************************************************************************************
;TMR1 INITIALIZATION ROUTINE
;*************************************************************************************
INIT_TMR1
	MOVLW   0XB0
	MOVWF   T1CON       ;TMR1 WITH PS=1:8 AND 16 BIT WRITE
	MOVLW   TMR1H_COUNT ;TMR1 LOADED WITH COUNT FOR 100MSEC INT
	MOVWF   TMR1H
	MOVLW   TMR1L_COUNT
	MOVWF   TMR1L
	BSF	T1CON,TMR1ON    ;TURN ON TMR1
	RETURN
;*************************************************************************************
;PWM INITIALIZATION ROUTINE
;*************************************************************************************
INIT_PWM
	CLRF    PTCON1
	MOVLW   0X00
	MOVWF   PTCON0      ;PWM TIME BASE PS=1:1, POST SCALAR=1:1, FREE RUNNING MODE
	MOVLW   0X4F
	MOVWF   PWMCON0     ;PWM0-5 ENABLED, INDEPENDENT MODE
	MOVLW   0X01
	MOVWF   PWMCON1     ;OUTPUT OVERRIDE SYNCHRONIZED WRT PWM TIME BASE
	MOVLW   0X00
	MOVWF   DTCON       ;ZERO DEAD TIME
	CLRF    OVDCOND     ;PWM PIN STATUS CONTROLLED BY OVDCONS
	CLRF    OVDCONS     ;PWM PIN IN INACTIVE STATE
	MOVLW   0X03
	MOVWF   FLTCONFIG
	CLRF    SEVTCMPL    ;CLEAR SPECIAL EVENT COMPARE VALUE
	CLRF    SEVTCMPH
	CLRF    PDC0L       ;ALL PWM DUTY CYCLE REGISTERS SET TO ZERO
	CLRF    PDC1L
	CLRF    PDC2L
	CLRF    PDC0H
	CLRF    PDC1H
	CLRF    PDC2H
	RETURN
;*************************************************************************************
;PWM CONFIGURATION ROUTINE AFTER DOWNLOAD COMMAND
;*************************************************************************************
CONFIGURE_PWM
	MOVFF   PARAMETER_BUFFER+LOC_PWM_TYPE_FREQ,WREG
	BTFSC   WREG,PWM_ALIGNMENT
	BSF	PTCON0,PTMOD1
	BTFSS   WREG,PWM_ALIGNMENT
	BCF	PTCON0,PTMOD1
	MOVFF   PARAMETER_BUFFER+LOC_PTPER_LSB,PTPERL
	MOVFF   PARAMETER_BUFFER+LOC_PTPER_MSB,PTPERH
	MOVLW   0X80
	MOVWF   PTCON1          ;ENABLE PWM TIMER
	RETURN
;*************************************************************************************
;ROUTINE TO INITIALIZE PORTS
;*************************************************************************************
INIT_PORTS
	MOVLW   0XFF
	MOVWF   TRISA       ;RA<0:5> AS INPUT
	MOVLW   0XC0
	MOVWF   TRISB       ;RB<0:5> AS OUTPUT AND RB<6:7> AS INPUT
	MOVLW   TRISC_VALUE
	MOVWF   TRISC       ;RC0 AS OUTPUT AN RC<1:7> AS INPUT
	RETURN
;*************************************************************************************
;ROUTINE TO INITIALIZE MOTION FEEDBACK MODULE
;*************************************************************************************
INIT_MOTION_FEEDBACK_MODULE
	MOVLW   0X59
	MOVWF   T5CON
	MOVLW   0X48        ;CAPTURE AT EVERY INPUT CHANGE FOR IC1
	MOVWF   CAP1CON
	MOVLW   0X48        ;CAPTURE AT EVERY INPUT CHANGE FOR IC2
	MOVWF   CAP2CON
	MOVLW   0X48        ;CAPTURE AT EVERY INPUT CHANGE FOR IC3
	MOVWF   CAP3CON
	CLRF    DFLTCON     ;DISABLE DIGITAL FILTER MODULE
	MOVLW   0X80
	MOVWF   QEICON      ;DISABLE QEI AND VELOCITY MEASUREMENT
	RETURN
;*************************************************************************************
;ROUTINE TO LOAD SEQUENCE TABLE FOR HALL SENSOR STAUS
;*************************************************************************************
LOAD_SEQUENCE_TABLE
	MOVFF   PARAMETER_BUFFER+LOC_FEEDBACK_DEVICE,WREG
	BTFSC   WREG,HALL_ANGLE_BIT
	BRA	LOAD_TABLE_FOR_120DEG_HALL
LOAD_TABLE_FOR_60DEG_HALL
;FORWARD SEQUENCE FOR 60DEG HALL
	MOVLW   POSITION2
	MOVWF   POSITION_TABLE_FWD
	MOVLW   POSITION3
	MOVWF   POSITION_TABLE_FWD+1
	MOVLW   DUMMY_POSITION
	MOVWF   POSITION_TABLE_FWD+2
	MOVLW   POSITION4
	MOVWF   POSITION_TABLE_FWD+3
	MOVLW   POSITION1
	MOVWF   POSITION_TABLE_FWD+4
	MOVLW   DUMMY_POSITION
	MOVWF   POSITION_TABLE_FWD+5
	MOVLW   POSITION6
	MOVWF   POSITION_TABLE_FWD+6
	MOVLW   POSITION5
	MOVWF   POSITION_TABLE_FWD+7
;REVERSE SEQUENCE FOR 60DEG HALL
	MOVLW   POSITION5
	MOVWF   POSITION_TABLE_REV
	MOVLW   POSITION6
	MOVWF   POSITION_TABLE_REV+1
	MOVLW   DUMMY_POSITION
	MOVWF   POSITION_TABLE_REV+2
	MOVLW   POSITION1
	MOVWF   POSITION_TABLE_REV+3
	MOVLW   POSITION4
	MOVWF   POSITION_TABLE_REV+4
	MOVLW   DUMMY_POSITION
	MOVWF   POSITION_TABLE_REV+5
	MOVLW   POSITION3
	MOVWF   POSITION_TABLE_REV+6
	MOVLW   POSITION2
	MOVWF   POSITION_TABLE_REV+7
	RETURN
LOAD_TABLE_FOR_120DEG_HALL
;FORWARD SEQUENCE FOR 120DEG HALL
	MOVLW	DUMMY_POSITION
	MOVWF	POSITION_TABLE_FWD
	MOVLW	POSITION1
	MOVWF	POSITION_TABLE_FWD+1
	MOVLW	POSITION2
	MOVWF	POSITION_TABLE_FWD+2
	MOVLW	POSITION3
	MOVWF	POSITION_TABLE_FWD+3
	MOVLW	POSITION4
	MOVWF	POSITION_TABLE_FWD+4
	MOVLW	POSITION5
	MOVWF	POSITION_TABLE_FWD+5
	MOVLW	POSITION6
	MOVWF	POSITION_TABLE_FWD+6
	MOVLW	DUMMY_POSITION
	MOVWF	POSITION_TABLE_FWD+7
;REVERSE SEQUENCE FOR 120DEG HALL
	MOVLW	DUMMY_POSITION
	MOVWF	POSITION_TABLE_REV
	MOVLW	POSITION6
	MOVWF	POSITION_TABLE_REV+1
	MOVLW	POSITION5
	MOVWF	POSITION_TABLE_REV+2
	MOVLW	POSITION4
	MOVWF	POSITION_TABLE_REV+3
	MOVLW	POSITION3
	MOVWF	POSITION_TABLE_REV+4
	MOVLW	POSITION2
	MOVWF	POSITION_TABLE_REV+5
	MOVLW	POSITION1
	MOVWF	POSITION_TABLE_REV+6
	MOVLW	DUMMY_POSITION
	MOVWF	POSITION_TABLE_REV+7	
	RETURN
;*************************************************************************************
;ROUTINE TO INITIALIZE ALL INTERRUPTS
;*************************************************************************************
INIT_INTERRUPT
	CLRF    INTCON			;DISABLE ALL INTERRUPTS
	CLRF    INTCON2
	CLRF    INTCON3
	CLRF    PIE1			;DISABLE ALL INTERRUPTS
	CLRF    PIE2
	CLRF    PIE3
	CLRF    PIR1			;CLEAR ALL INTERRUPT FLAGS
	CLRF    PIR2
	CLRF    PIR3
	CLRF    IPR1			;ALL INTERRUPTS ARE ASSIAGNED LOW PRIORITY
	CLRF    IPR2
	CLRF    IPR3
	BSF	IPR1,ADIP		;ASSIGN HIGH PRIORITY TO ADC INTERRUPT
	BSF	IPR3,IC1IP		;ASSIGN HIGH PRIORITY TO IC1 INTERRUPT
	BSF	IPR3,IC2QEIP		;ASSIGN HIGH PRIORITY TO IC2 INTERRUPT
	BSF	IPR3,IC3DRIP		;ASSIGN HIGH PRIORITY TO IC3 INTERRUPT
	BSF	PIE1,ADIE		;ENABLE ADC INTERRUPT
	
#IF ((ACTIVE_MODE == 0X01) || (ACTIVE_MODE == 0X02))
	BSF	PIE1,RCIE		;ENABLE RX INTERRUPT
#ENDIF

	BSF	PIE1,TMR1IE		;ENABLE TMR1 INTERRUPT
	BSF	PIE3,IC1IE		;ENABLE IC1 INTERRUPT
	BSF	PIE3,IC2QEIE		;ENABLE IC2 INTERRUPT
	BSF	PIE3,IC3DRIE		;ENABLE IC3 INTERRUPT
	MOVLW   0X93
	MOVWF   RCON			;POR AND BOR FLAG SET, ENABLE INTERRUPT PRIORITY
	BSF	INTCON,PEIE		;ENABLE PERIPHERAL INTERRUPT
	BSF	INTCON,GIE		;ENABLE GLOBAL INTERRUPT
	RETURN
;*************************************************************************************
;ROUTINE TO READ LAST SAVED SYSTEM PARAMETERS FROM DATA EEPROM
;*************************************************************************************
READ_SYSTEM_PARAMETERS
	LFSR	FSR0,PARAMETER_BUFFER	;LOAD PARAMETER_BUFFER BASE ADDRESS
	MOVLW	SYSTEM_PARAMETER_COUNT
	MOVWF	TEMPHOSTDATALEN		;LOAD SYSTEM PARAMETERS COUNT
	BCF	EECON1,CFGS		;ACCESS FLASH/EEPROM MEMORY
	BCF	EECON1,EEPGD		;ACCESS EEPROM MEMORY
	CLRF	EEADR			;POINT TO FIRST DATA TO BE READ
NEXT_READ
	BSF	EECON1,RD		;ENABLE READ
	MOVFF	EEDATA,POSTINC0
	INCF	EEADR			;POINT TO NEXT DATA TO BE READ
	DECFSZ	TEMPHOSTDATALEN		;ALL DATA READ COMPLETE?
	BRA	NEXT_READ		;NO - READ NEXT DATA
	RETURN				;YES - ALL READ OVER. RETURN TO MAIN
;*******************************************************************************
;THIS ROUTINE CHECKS FOR THE KEYS STATUS. 2 KEYS ARE CHECKED, RUN/STOP AND
;FORWARD(FWD)/REVERSE(REV)
;*******************************************************************************
#IF ((ACTIVE_MODE == 0X01) || (ACTIVE_MODE == 0X03))
KEY_CHECK
	BTFSC	KEY_PORT,RUN_STOP_KEY           ;IS KEY PRESSED "RUN/STOP"?
	GOTO	CHECK_FWD_REV_KEY
	BTFSC	BLDC_FLAGS_1,DEBOUNCE
	RETURN
	CALL	KEY_DEBOUNCE
	BTFSS	BLDC_FLAGS_1,DEBOUNCE
	RETURN
	BSF	BLDC_FLAGS_1,KEY_RS
	RETURN
CHECK_FWD_REV_KEY
	BTFSC	KEY_PORT,FWD_REV_KEY            ;IS KEY PRESSED "FWD/REV"?
	GOTO    SET_KEYS
	BTFSC   BLDC_FLAGS_1,DEBOUNCE
	RETURN
	CALL    KEY_DEBOUNCE
	BTFSS   BLDC_FLAGS_1,DEBOUNCE
	RETURN
	BSF	BLDC_FLAGS_1,KEY_FR
	RETURN
SET_KEYS
	BTFSS   BLDC_FLAGS_1,DEBOUNCE
	RETURN
	BCF	BLDC_FLAGS_1,DEBOUNCE
	BSF	BLDC_FLAGS_1,KEY_PRESSED
	BTFSS   BLDC_FLAGS_1,KEY_RS
	RETURN
	BTG	BLDC_FLAGS_1,RUN_STOP
	RETURN
;*******************************************************************************
;ROUTINE FOR KEY DEBOUNCE
;*******************************************************************************
KEY_DEBOUNCE
	DECFSZ	DEBOUNCE_COUNTER,F
	RETURN
	BSF	BLDC_FLAGS_1,DEBOUNCE
	MOVLW	DEBOUNCE_COUNT
	MOVWF	DEBOUNCE_COUNTER
	RETURN
#ENDIF
;*******************************************************************************
;DELAY ROUTINE.
;*******************************************************************************
DELAY
	MOVLW   DELAY_COUNT1
	MOVWF   COUNTER
DEC_COUNT
	MOVLW   DELAY_COUNT2
	MOVWF   COUNTER1
DEC_COUNT1
	DECFSZ  COUNTER1,F
	GOTO    DEC_COUNT1
	DECFSZ  COUNTER,F
	GOTO    DEC_COUNT
	CLRF    COUNTER
	CLRF    COUNTER1
	RETURN
;*************************************************************************************
;ROUTINE TO CLEAR ALL GPRS
;*************************************************************************************
CLEAR_ALL_RAM
	LFSR	FSR0,0X0000 		;LOAD FSR0 WITH 00H ADDRESS
NEXT    
	CLRF	POSTINC0    		;CLEAR INDF REGISTER THEN INC POINTER
	BTFSS	FSR0H,1     		;ALL DONE WITH BANK0, BANK1 AND BANK2?
	BRA 	NEXT        		;NO, CLEAR NEXT RAM
	BTFSS   FSR0L,7     		;ALL DONE WITH BANK0, BANK1 AND BANK2?
	BRA 	NEXT        		;NO, CLEAR NEXT RAM
	RETURN          		;YES - RETURN TO MAIN
;*************************************************************************************
;ROUTINE TO CLEAR ALL LED
;*************************************************************************************
CLEAR_ALL_LED
	BCF	PORTC,LED1          	;ALL LED OFF
	BCF	PORTC,LED2
	BCF	PORTC,LED3
	RETURN
;*************************************************************************************
;ROUTINE FOR ACCELERATION AND DECELERATION
;*************************************************************************************
#IFDEF  RAMP
RAMP_SPEED
	MOVF    REQD_SPEED_RPS,W	;CHECK ANY CHANGE IN ACTUAL SPEED REQUIRED?
	SUBWF   ACTUAL_SPEED_RPS,W
	BTFSC   STATUS,Z
	BRA	NO_RAMP			;ACTUAL AND REQUIRED SPEED EQUAL, NO CHANGE
	BTFSS   STATUS,C
	BRA	RAMP_UP
RAMP_DOWN				;ROUTINE TO DECREASE ACTUAL SPEED
	MOVFF   PARAMETER_BUFFER+LOC_DECELERATION_RATE,WREG
	SUBWF   ACTUAL_SPEED_RPS,W
	BTFSS   STATUS,C
	CLRF    WREG
	MOVWF   TEMP_SPEED_RPS
	CPFSLT  REQD_SPEED_RPS
	MOVFF   REQD_SPEED_RPS,TEMP_SPEED_RPS
	MOVFF   TEMP_SPEED_RPS,ACTUAL_SPEED_RPS
	BRA	NO_RAMP
RAMP_UP					;ROUTINE TO INCREASE ACTUAL SPEED
	MOVFF   PARAMETER_BUFFER+LOC_ACCELERATION_RATE,PDC_TEMPL
	MOVF    ACTUAL_SPEED_RPS,W
	ADDWF   PDC_TEMPL,W
	BTFSC   STATUS,C
	MOVLW   0XFF
	MOVWF   TEMP_SPEED_RPS
	CPFSGT  REQD_SPEED_RPS
	MOVFF   REQD_SPEED_RPS,TEMP_SPEED_RPS
	MOVFF   TEMP_SPEED_RPS,ACTUAL_SPEED_RPS
NO_RAMP
	CLRF    RAMP_COUNT
	RETURN
#ENDIF
;*************************************************************************************
;ROUTINE FOR ALL FAULT PROTECTION
;CALLED AT EVERY TMR1 OVERFLOW
;*************************************************************************************
FAULT_CHECK
	BCF	BLDC_FLAGS_1,TMR1_OF
	INCF	FAULT_CHECK_COUNT,F
	MOVLW	MAX_FAULT_CHECK_COUNT
	CPFSGT	FAULT_CHECK_COUNT	;CHECK FOR FAULT CHECK COUNT LIMIT	
	BRA	CHECK_FLTAS
	CLRF	FAULTA_COUNT
	CLRF	FAULT_CHECK_COUNT

CHECK_FLTAS
	BTFSS	FLTCONFIG,FLTAS		;IS FLTA ACTIVE?
	BRA	FAULT_DISPLAY
	INCF	FAULTA_COUNT,F
	MOVLW	MAX_FLTA_COUNT
	CPFSGT	FAULTA_COUNT		;IS FLTA ACTIVE FOR MORE THAN SET LIMIT COUNT
	BRA	FAULT_DISPLAY
	BCF	FLTCONFIG,FLTAMOD	;YES - ACTIVATE CATASTROPHIC MODE FOR FLTA
	CALL	STOP_MOTOR_NOW		;STOP THE MOTOR
	BCF	BLDC_FLAGS_1,RUN_STOP	
	BSF	FLT_FLAGS,OCUR		;SET FLAG FOR OC FAULT
	BSF	FLT_FLAGS_1,FAULT

FAULT_DISPLAY				;ROUTINE TO DISPLAY FAULT, IF ANY	
	BTFSS	FLT_FLAGS_1,FAULT
	BRA	CHECK_DISPLAY_COUNT
	BTFSS	FLT_FLAGS_1,CLEAR_LED_ONCE
	CALL	CLEAR_ALL_LED
	BSF	FLT_FLAGS_1,CLEAR_LED_ONCE
CHECK_DISPLAY_COUNT
	INCF	CYCLE_COUNT,F
	MOVLW	CYCLE_COUNT_MAX
	CPFSGT	CYCLE_COUNT
	RETURN
	CLRF	CYCLE_COUNT
	BTFSC	FLT_FLAGS,OCUR
	BTG	PORTC,LED1
	RETURN
;*************************************************************************************
;CONVERT MANUAL MODE ADC READ FOR SPEED TO RPS DEPENDING ON MOTOR PARAMETER
;FOR IT TO WORK PROPERLY, FIRST TIME IT SHOULD RUN WITH GUI
;*************************************************************************************
#IF ((ACTIVE_MODE == 0X01) || (ACTIVE_MODE == 0X03))
CONVERT_MANUAL_COUNT_TO_RPS
	MOVFF   PARAMETER_BUFFER+LOC_MOTOR_SPEED_RPS,WREG
	MULWF   REQD_SPEED_REFH
	MOVFF   PRODH,REQD_SPEED_RPS
	RETURN
#ENDIF
;*************************************************************************************
;END OF FILE
;*************************************************************************************
	END
