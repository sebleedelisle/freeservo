;GUI INTERFACE CODE VARIABLE DEFINITION

#IFDEF	INTERFACEBLDC
	UDATA_ACS			;DO NOT DELETE ANY
ISR_WREG		RES	1	;LOCATION FOR CONTEXT SAVING FOR LOW PRIORITY INT.
ISR_STATUS		RES	1	;LOCATION FOR CONTEXT SAVING FOR LOW PRIORITY INT.
ISR_BSR			RES	1	;LOCATION FOR CONTEXT SAVING FOR LOW PRIORITY INT.
REQD_SPEED_REFH		RES	1	;STORES POT SETTING FOR SPEED
REQD_SPEED_RPS		RES	1	;STORES REQD SPEED INFO IN RPS
ACTUAL_SPEED_RPS	RES	1	;STORES ACTUAL SPEED INFO IN RPS
TEMP_SPEED_RPS		RES	1	
RAMP_COUNT		RES	1	;COUNTER FOR RAMP
BLDC_FLAGS		RES	1	
BLDC_FLAGS_1		RES	1
DEBOUNCE_COUNTER	RES	1
COUNTER			RES	1	;COUNTER FOR DELAY
COUNTER1		RES	1	;COUNTER FOR DELAY
COUNTER2		RES	1	;COUNTER FOR DELAY
POSITION_TABLE_FWD	RES	8	;TABLE FOR STORING OUPUT PWM PATTERN AS PER HALL INPUT IN FWD DIR
POSITION_TABLE_REV	RES	8	;TABLE FOR STORING OUPUT PWM PATTERN AS PER HALL INPUT IN REV DIR
CURRENT_UH		RES	1	;STORS DC CURRENT OR R PHASE CURRENT
CURRENT_VH		RES	1	;STORES Y PHASE CURRENT
CURRENT_WH		RES	1	;STORES B PHASE CURRET
JUNCTION_TEMPH		RES	1	;STORED INVERTER JUNCTION TEMPERATURE
PDC_TEMPH		RES	1
PDC_TEMPL		RES	1
CYCLE_COUNT		RES	1	;STORES COUNT FOR FAULT DISPLAY RATE
FAULTA_COUNT		RES	1	;COUNTER FOR ACTIVE FLTA IN FAULT CHECK TIME WINDOW
FAULTB_COUNT		RES	1	;COUNTER FOR ACTIVE FLTB IN FAULT CHECK TIME WINDOW
FLT_FLAGS		RES	1	;STORES INFO ABT ACTIVE FAULT
FLT_FLAGS_1		RES	1
FAULT_CHECK_COUNT	RES	1	;COUNTER FOR DECIDING FAULT CHECK TIME WINDOW


	UDATA		0X100		;DO NOT DELETE ANY
GUI_FLAGS		RES	1
ISR_FSR0L		RES	1	;LOCATION FOR FSR0<H:L> SAVING IN INTERRUPT
ISR_FSR0H		RES	1
ISR_FSR1L		RES	1	;LOCATION FOR FSR1<H:L> SAVING IN INTERRUPT
ISR_FSR1H		RES	1
LAST_ADC		RES	1	;USED IN ISR_TMR1
TEMP_LAST_ADC		RES	1
TEMPHOSTDATALEN 	RES     1

#IF ((ACTIVE_MODE == 0X01) || (ACTIVE_MODE == 0X02))
UARTINT_STATUS          RES     1
UARTINT_TX_BUF_DATACNT  RES     1       ;TRANSMIT BUFFER DATA COUNT
UARTINT_TX_BUF_WRPTR    RES     1	;TRANSMIT BUFFER WRITE POINTER
UARTINT_TX_BUF_RDPTR    RES     1	;TRANSMIT BUFFER READ POINTER
UARTINT_RX_BUF_DATACNT  RES     1       ;RECEIVE BUFFER DATA COUNT
UARTINT_RX_BUF_WRPTR    RES     1       ;RECEIVE BUFFER WRITE POINTER
UARTINT_RX_BUF_RDPTR    RES     1       ;RECEIVE BUFFER READ POINTER
HOSTRESPONSE_BUF_STATUS	RES     1
HOST_BUF_DATACNT    	RES     1	;HOST BUFFER DATA COUNT
HOST_BUF_WRPTR   	RES     1	;HOST BUFFER WRITE POINTER
HOST_BUF_RDPTR	      	RES     1	;HOST BUFFER READ POINTER
RESPONSE_BUF_DATACNT    RES     1	;RESPONSE BUFFER DATA COUNT
RESPONSE_BUF_WRPTR   	RES     1	;RESPONSE BUFFER WRITE POINTER
RESPONSE_BUF_RDPTR      RES     1	;RESPONSE BUFFER READ POINTER
TEMP1			RES     1	;USED IN ISR_RX
TEMP2			RES	1	;USED IN PARSEHOSTCMD_EXECSTATE,SENDHOSTDATA_EXECSTATE
TEMP3			RES     1	;USED IN UARTINTGETCH,UARTINTPUTCH
TEMP4			RES	1	;USED IN HOSTBUFGETCH,HOSTBUFPUTCH
TEMP5			RES	1	;USED IN RESPONSEBUFGETCH,RESPONSEBUFPUTCH
TMR1_OF_COUNT_LSB	RES	1	;COUNTER FOR DEFINING FW TIMEOUT
TMR1_OF_COUNT_MSB	RES	1	;COUNTER FOR DEFINING FW TIMEOUT
RESPONSE		RES	1	;COMMAND ID FROM FW TO GUI
RESPONSEDATALEN		RES	1	;DATA BYTE LENGTH FROM FW TO GUI
RESPONSEDATA		RES	1	;COPY OF RESPONSEDATALEN
;****************************************************************************
; HOST COMMAND PARSER FSM VARIABLES (DO NOT DELETE ANY)
;****************************************************************************
SMHOST          	RES     1
SMHOSTFLAGS     	RES     1
HOSTCHECKSUM    	RES     1
USARTBYTE       	RES     1
;****************************************************************************
; HOST COMMAND VARIABLES (DO NOT DELETE ANY)
;****************************************************************************
HOSTCMD         	RES     1
HOSTDATALEN     	RES     1
;****************************************************************************
;BUFFER RAM ALLOCATION (DO NOT CHANGE)
;****************************************************************************
UARTINT_TX_BUFFER	RES     UARTINT_TX_BUFFER_SIZE	;TRANSMIT DATA FIFO BUFFER
UARTINT_RX_BUFFER	RES     UARTINT_RX_BUFFER_SIZE	;RECEIVE DATA FIFO BUFFER
HOST_BUFFER		RES     HOST_BUFFER_SIZE   	;RECEIVE DATA FIFO BUFFER
RESPONSE_BUFFER		RES     RESPONSE_BUFFER_SIZE	;RECEIVE DATA FIFO BUFFER
#ENDIF
PARAMETER_BUFFER	RES	PARAMETER_BUFFER_SIZE	;PARAMETER BUFFER


	GLOBAL	ISR_WREG,ISR_STATUS,ISR_BSR,REQD_SPEED_REFH,REQD_SPEED_RPS,ACTUAL_SPEED_RPS,TEMP_SPEED_RPS
	GLOBAL	RAMP_COUNT,BLDC_FLAGS,BLDC_FLAGS_1,DEBOUNCE_COUNTER,COUNTER,COUNTER1,COUNTER2,POSITION_TABLE_FWD
	GLOBAL	POSITION_TABLE_REV,CURRENT_UH,CURRENT_VH,CURRENT_WH,JUNCTION_TEMPH,PDC_TEMPH,PDC_TEMPL,CYCLE_COUNT
	GLOBAL	FAULTA_COUNT,FAULTB_COUNT,FLT_FLAGS,FLT_FLAGS_1,FAULT_CHECK_COUNT,GUI_FLAGS,ISR_FSR0L,ISR_FSR0H,ISR_FSR1L
	GLOBAL	ISR_FSR1H,LAST_ADC,TEMP_LAST_ADC,TEMPHOSTDATALEN,PARAMETER_BUFFER

#IF ((ACTIVE_MODE == 0X01) || (ACTIVE_MODE == 0X02))
	GLOBAL	UARTINT_STATUS,UARTINT_TX_BUF_DATACNT,UARTINT_TX_BUF_WRPTR,UARTINT_TX_BUF_RDPTR,UARTINT_RX_BUF_DATACNT
	GLOBAL	UARTINT_RX_BUF_WRPTR,UARTINT_RX_BUF_RDPTR,HOSTRESPONSE_BUF_STATUS,HOST_BUF_DATACNT,HOST_BUF_WRPTR
	GLOBAL	HOST_BUF_RDPTR,RESPONSE_BUF_DATACNT,RESPONSE_BUF_WRPTR,RESPONSE_BUF_RDPTR,TEMP1,TEMP2,TEMP3,TEMP4,TEMP5
	GLOBAL	TMR1_OF_COUNT_LSB,TMR1_OF_COUNT_MSB,RESPONSE,RESPONSEDATALEN,RESPONSEDATA,SMHOST,SMHOSTFLAGS
	GLOBAL	HOSTCHECKSUM,USARTBYTE,HOSTCMD,HOSTDATALEN,UARTINT_TX_BUFFER,UARTINT_RX_BUFFER,HOST_BUFFER,RESPONSE_BUFFER
#ENDIF

#ELSE
	EXTERN	ISR_WREG,ISR_STATUS,ISR_BSR,REQD_SPEED_REFH,REQD_SPEED_RPS,ACTUAL_SPEED_RPS,TEMP_SPEED_RPS
	EXTERN	RAMP_COUNT,BLDC_FLAGS,BLDC_FLAGS_1,DEBOUNCE_COUNTER,COUNTER,COUNTER1,COUNTER2,POSITION_TABLE_FWD
	EXTERN	POSITION_TABLE_REV,CURRENT_UH,CURRENT_VH,CURRENT_WH,JUNCTION_TEMPH,PDC_TEMPH,PDC_TEMPL,CYCLE_COUNT
	EXTERN	FAULTA_COUNT,FAULTB_COUNT,FLT_FLAGS,FLT_FLAGS_1,FAULT_CHECK_COUNT,GUI_FLAGS,ISR_FSR0L,ISR_FSR0H,ISR_FSR1L
	EXTERN	ISR_FSR1H,LAST_ADC,TEMP_LAST_ADC,TEMPHOSTDATALEN,PARAMETER_BUFFER

#IF ((ACTIVE_MODE == 0X01) || (ACTIVE_MODE == 0X02))
	EXTERN	UARTINT_STATUS,UARTINT_TX_BUF_DATACNT,UARTINT_TX_BUF_WRPTR,UARTINT_TX_BUF_RDPTR,UARTINT_RX_BUF_DATACNT
	EXTERN	UARTINT_RX_BUF_WRPTR,UARTINT_RX_BUF_RDPTR,HOSTRESPONSE_BUF_STATUS,HOST_BUF_DATACNT,HOST_BUF_WRPTR
	EXTERN	HOST_BUF_RDPTR,RESPONSE_BUF_DATACNT,RESPONSE_BUF_WRPTR,RESPONSE_BUF_RDPTR,TEMP1,TEMP2,TEMP3,TEMP4,TEMP5
	EXTERN	TMR1_OF_COUNT_LSB,TMR1_OF_COUNT_MSB,RESPONSE,RESPONSEDATALEN,RESPONSEDATA,SMHOST,SMHOSTFLAGS
	EXTERN	HOSTCHECKSUM,USARTBYTE,HOSTCMD,HOSTDATALEN,UARTINT_TX_BUFFER,UARTINT_RX_BUFFER,HOST_BUFFER,RESPONSE_BUFFER
#ENDIF
#ENDIF
